## application/samples/peripheral/My_project_2x/Kconfig
```kconfig
if SAMPLE_SUPPORT_MY_PROJECT_2X

menu "My_project_2x Configuration"

config MY_PROJECT_2X_LED_GPIO
    int "LED GPIO number"
    default 9
    help
        GPIO number for LED output.

config MY_PROJECT_2X_BEEP_GPIO
    int "BEEP GPIO number"
    default 8
    help
        GPIO number for buzzer/beep output.

config MY_PROJECT_2X_BEEP_AUTO_OFF_MS
    int "Beep auto-off timeout (ms)"
    default 15000
    range 1000 60000
    help
        Safety timeout to prevent battery drain. Must auto-off even if link is lost.

config MY_PROJECT_2X_PWM_PIN
    int "PWM pin for passive buzzer"
    default 20
    help
        GPIO pin number for PWM output to drive passive buzzer.

config MY_PROJECT_2X_PWM_PIN_MODE
    int "PWM pin multiplex mode"
    default 40
    help
        Pin function mode for PWM output on the specified GPIO.

config MY_PROJECT_2X_PWM_CHANNEL
    int "PWM channel"
    default 0
    help
        PWM channel number for buzzer output.

config MY_PROJECT_2X_PWM_GROUP_ID
    int "PWM group ID (V151 only)"
    default 0
    depends on PWM_USING_V151
    help
        PWM group ID when using V151 PWM controller.

endmenu

osource "application/samples/peripheral/My_project_2x/components/shared_protocol/Kconfig"
osource "application/samples/peripheral/My_project_2x/components/hardware_hal/Kconfig"
osource "application/samples/peripheral/My_project_2x/components/sle_slave/Kconfig"
osource "application/samples/peripheral/My_project_2x/components/storage_sync/Kconfig"

endif # SAMPLE_SUPPORT_MY_PROJECT_2X
```

## application/samples/peripheral/My_project_2x/components/hardware_hal/Kconfig
```kconfig
# My_project_2x hardware_hal

config MY_PROJECT_2X_HARDWARE_HAL_ENABLE
    bool "Enable hardware_hal component"
    default y
    depends on SAMPLE_SUPPORT_MY_PROJECT_2X
```

## application/samples/peripheral/My_project_2x/components/shared_protocol/Kconfig
```kconfig
# My_project_2x shared_protocol

config MY_PROJECT_2X_SHARED_PROTOCOL_ENABLE
    bool "Enable shared_protocol component"
    default y
    depends on SAMPLE_SUPPORT_MY_PROJECT_2X
```

## application/samples/peripheral/My_project_2x/components/sle_slave/Kconfig
```kconfig
# My_project_2x sle_slave

config MY_PROJECT_2X_SLE_SLAVE_ENABLE
    bool "Enable sle_slave component"
    default y
    depends on SAMPLE_SUPPORT_MY_PROJECT_2X

config MY_PROJECT_2X_MAX_CONNECTIONS
    int "Maximum SLE connections"
    default 4
    range 1 8
    depends on MY_PROJECT_2X_SLE_SLAVE_ENABLE
    help
        Maximum number of simultaneous SLE connections.
        Each connection consumes memory for conn_id tracking.
```

## application/samples/peripheral/My_project_2x/components/storage_sync/Kconfig
```kconfig
# My_project_2x storage_sync

config MY_PROJECT_2X_STORAGE_SYNC_ENABLE
    bool "Enable storage_sync component"
    default y
    depends on SAMPLE_SUPPORT_MY_PROJECT_2X
```
